## config/boards/shields/left_bbtrackball_dongle/Kconfig.shield
```kconfig
# Copyright (c) 2022 The ZMK Contributors
# SPDX-License-Identifier: MIT

config SHIELD_LEFT_BBTRACKBALL_DONGLE
    def_bool $(shields_list_contains,left_bbtrackball_dongle)

menu "BBtrackball Setting"


config BBtrackball_lighted_when_moved
	bool "BBtrackball led lighted when moved"

config BBtrackball_max_brightness
    int "BBtrackball brightness when moved"
    default 20
    range 0 100
    help
      The brightness when you move the BB trackball

config BBtrackball_IDLE_POWER_DOWN_MS
    int "Milliseconds without trackball movement before its GPIOs are powered down"
    default 60000
    help
      The four trackball direction lines are held by internal pull-ups. Every
      line the encoder holds low sinks ~230uA continuously, which is far more
      than the rest of the half draws while idle. After this many milliseconds
      without trackball movement the lines are set to Hi-Z and their interrupts
      are disabled. They are restored on the next key press on this half (or
      when the half wakes up). Set to 0 to disable the idle power down.

config BBtrackball_EDGE_DEBOUNCE_US
    int "Minimum microseconds between two accepted edges on the same trackball line"
    default 300
    help
      Edges closer together than this are treated as contact chatter/noise and
      ignored. Keep well below the fastest real pulse rate of the encoder.

config BBtrackball_MOVE_START_THRESHOLD
    int "Accumulated pixels required before a new trackball movement is reported"
    default 6
    help
      A single stray pulse is not a movement. Until this much movement has
      accumulated within BBtrackball_MOVE_BURST_WINDOW_MS no input event is
      emitted, so noise cannot keep resetting ZMK's idle/sleep timer.

config BBtrackball_MOVE_BURST_WINDOW_MS
    int "Milliseconds a partial trackball movement is kept before it is discarded"
    default 400

endmenu
```

## config/dts/bindings/input_processors/zmk,input-processor-trackpad-mode.yaml
```yaml
# Copyright (c) 2026 The ZMK Contributors
# SPDX-License-Identifier: MIT

description: Convert trackpad wheel events to pointer events while pointer mode is active

compatible: "zmk,input-processor-trackpad-mode"

include: ip_zero_param.yaml
```
